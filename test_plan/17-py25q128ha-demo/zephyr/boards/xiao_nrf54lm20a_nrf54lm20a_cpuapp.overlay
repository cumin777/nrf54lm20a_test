/*
 * PY25Q64HA-UXH-IR wiring on XIAO nRF54LM20A
 * CS   -> P2.05
 * IO0  -> P2.02 (MOSI)
 * IO1  -> P2.04 (MISO)
 * IO2  -> P2.03 (WP#)
 * IO3  -> P2.00 (HOLD#)
 * CLK  -> P2.01
 */

&spi00 {
	status = "okay";
	cs-gpios = <&gpio2 5 GPIO_ACTIVE_LOW>;
};

&py25q64 {
	status = "okay";
	spi-max-frequency = <8000000>;
	wp-gpios = <&gpio2 3 GPIO_ACTIVE_LOW>;
	hold-gpios = <&gpio2 0 GPIO_ACTIVE_LOW>;

	partitions {
		compatible = "fixed-partitions";
		#address-cells = <1>;
		#size-cells = <1>;

		py25q128_demo_partition: partition@0 {
			label = "py25q128_demo";
			reg = <0x00000000 0x00010000>;
		};
	};
};
