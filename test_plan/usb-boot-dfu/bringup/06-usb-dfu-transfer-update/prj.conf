## Kconfig.sysbuild
```
config PARTITION_MANAGER
	default n

config MCUBOOT_SIGNATURE_USING_KMU
	default y if SOC_SERIES_NRF54L && !SOC_NRF54LS05B

config MCUBOOT_GENERATE_DEFAULT_KEY_FILE
	default y if SOC_SERIES_NRF54L && !SOC_NRF54LS05B

source "share/sysbuild/Kconfig"
```

## prj.conf
```kconfig
CONFIG_BOOTLOADER_MCUBOOT=y
CONFIG_GPIO=y
CONFIG_MCUBOOT_IMGTOOL_SIGN_VERSION="0.0.1+0"

CONFIG_SERIAL=n
CONFIG_CONSOLE=n
CONFIG_UART_CONSOLE=n
CONFIG_LOG=n
CONFIG_PRINTK=n
CONFIG_USB_DEVICE_STACK_NEXT=n
```

## src/main.c
```c
/* SPDX-License-Identifier: Apache-2.0 */

#include <zephyr/devicetree.h>
#include <zephyr/drivers/gpio.h>
#include <zephyr/kernel.h>

#define LED_NODE DT_ALIAS(led1)

#if !DT_NODE_HAS_STATUS(LED_NODE, okay) || !DT_NODE_HAS_PROP(LED_NODE, gpios)
#error "Unsupported board: led1 devicetree alias is not defined"
#endif

static const struct gpio_dt_spec led = GPIO_DT_SPEC_GET(LED_NODE, gpios);

int main(void)
{
	if (!gpio_is_ready_dt(&led)) {
		return 0;
	}

	gpio_pin_configure_dt(&led, GPIO_OUTPUT_INACTIVE);

	while (1) {
		gpio_pin_toggle_dt(&led);
		k_msleep(500);
	}
}
```
