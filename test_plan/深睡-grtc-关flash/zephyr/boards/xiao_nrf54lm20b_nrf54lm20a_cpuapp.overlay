/* XIAO nRF54LM20B board overlay — system off (GRTC wakeup) demo.
 * Enable the on-board external SPI flash (PY25Q128HA) at 8 MHz (the board
 * dtsi default of 133 MHz fails the boot-time JEDEC/SFDP probe -> device not
 * ready) so it can be suspended into Deep Power-Down before entering system off.
 */

&spi00 {
	status = "okay";
	cs-gpios = <&gpio2 5 GPIO_ACTIVE_LOW>;
};

&py25q128 {
	status = "okay";
	spi-max-frequency = <8000000>;
	wp-gpios = <&gpio2 3 GPIO_ACTIVE_LOW>;
	hold-gpios = <&gpio2 0 GPIO_ACTIVE_LOW>;
};
