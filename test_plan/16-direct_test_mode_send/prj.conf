## CMakeLists.txt
```
#
# Copyright (c) 2020 Nordic Semiconductor
#
# SPDX-License-Identifier: LicenseRef-Nordic-5-Clause
#
cmake_minimum_required(VERSION 3.20.0)

find_package(Zephyr REQUIRED HINTS $ENV{ZEPHYR_BASE})
project(direct_test_mode_send)

target_include_directories(app PRIVATE ./src)

target_sources_ifndef(CONFIG_DTM_TRANSPORT_HCI app PRIVATE
  src/transport/dtm_uart_twowire.c
)

target_sources_ifdef(CONFIG_DTM_TRANSPORT_HCI app PRIVATE src/transport/dtm_hci.c)

if(CONFIG_DTM_TRANSPORT_HCI AND "${BOARD}" STREQUAL "nrf5340dk")
  target_sources(app PRIVATE src/transport/hci_uart_remote.c)
  target_include_directories(app PRIVATE ./rpc)
else()
  target_sources_ifdef(CONFIG_DTM_TRANSPORT_HCI app PRIVATE src/transport/hci_uart.c)
endif()

# NORDIC SDK APP START
target_sources(app PRIVATE
  src/dtm.c
  src/dtm_hw.c
  src/main.c
)
# NORDIC SDK APP END
```

## sample.yaml
```
sample:
  description: Bluetooth Low Energy Direct Test Mode sample
  name: Bluetooth LE Direct Test Mode
tests:
  sample.bluetooth.direct_test_mode_send:
    sysbuild: true
    build_only: true
    integration_platforms:
      - nrf5340dk/nrf5340/cpunet
      - nrf21540dk/nrf52840
      - nrf52840dk/nrf52840
      - nrf54l15dk/nrf54l05/cpuapp
      - nrf54l15dk/nrf54l10/cpuapp
      - nrf54l15dk/nrf54l15/cpuapp
      - nrf54lm20dk/nrf54lm20a/cpuapp
      - nrf54lv10dk/nrf54lv10a/cpuapp
      - nrf54h20dk/nrf54h20/cpurad
    platform_allow:
      - nrf5340dk/nrf5340/cpunet
      - nrf21540dk/nrf52840
      - nrf52840dk/nrf52840
      - nrf54l15dk/nrf54l05/cpuapp
      - nrf54l15dk/nrf54l10/cpuapp
      - nrf54l15dk/nrf54l15/cpuapp
      - nrf54lm20dk/nrf54lm20a/cpuapp
      - nrf54lv10dk/nrf54lv10a/cpuapp
      - nrf54h20dk/nrf54h20/cpurad
    tags:
      - bluetooth
      - ci_build
      - sysbuild
  sample.bluetooth.direct_test_mode_send.hci:
    sysbuild: true
    build_only: true
    extra_args: FILE_SUFFIX=hci
    integration_platforms:
      - nrf5340dk/nrf5340/cpunet
      - nrf21540dk/nrf52840
      - nrf52840dk/nrf52840
      - nrf54l15dk/nrf54l15/cpuapp
      - nrf54h20dk/nrf54h20/cpurad
    platform_allow:
      - nrf5340dk/nrf5340/cpunet
      - nrf21540dk/nrf52840
      - nrf52840dk/nrf52840
      - nrf54l15dk/nrf54l15/cpuapp
      - nrf54h20dk/nrf54h20/cpurad
    tags:
      - bluetooth
      - ci_build
      - sysbuild
  sample.bluetooth.direct_test_mode_send.nrf5340_nrf21540:
    sysbuild: true
    build_only: true
    extra_args: SHIELD=nrf21540ek
    integration_platforms:
      - nrf5340dk/nrf5340/cpunet
    platform_allow: nrf5340dk/nrf5340/cpunet
    tags:
      - bluetooth
      - ci_build
      - sysbuild
  sample.bluetooth.direct_test_mode_send.nrf5340_usb:
    sysbuild: true
    build_only: true
    extra_args: FILE_SUFFIX=usb_5340
    integration_platforms:
      - nrf5340dk/nrf5340/cpunet
    platform_allow: nrf5340dk/nrf5340/cpunet
    tags:
      - bluetooth
      - ci_build
      - sysbuild
  sample.bluetooth.direct_test_mode_send.nrf5340_nrf21540_usb:
    sysbuild: true
    build_only: true
    extra_args:
      - SHIELD=nrf21540ek
      - FILE_SUFFIX=usb_5340
    integration_platforms:
      - nrf5340dk/nrf5340/cpunet
    platform_allow: nrf5340dk/nrf5340/cpunet
    tags:
      - bluetooth
      - ci_build
      - sysbuild
  sample.bluetooth.direct_test_mode_send.nrf5340_nrf21540.no_automatic_power:
    sysbuild: true
    build_only: true
    extra_args: SHIELD=nrf21540ek
    extra_configs:
      - CONFIG_DTM_POWER_CONTROL_AUTOMATIC=n
    integration_platforms:
      - nrf5340dk/nrf5340/cpunet
    platform_allow: nrf5340dk/nrf5340/cpunet
    tags:
      - bluetooth
      - ci_build
      - sysbuild
  sample.bluetooth.direct_test_mode_send.nrf5340_no_dfe:
    sysbuild: true
    build_only: true
    extra_args: DSB_CONFIG_DTM_NO_DFE=y
    integration_platforms:
      - nrf5340dk/nrf5340/cpunet
    platform_allow: nrf5340dk/nrf5340/cpunet
    tags:
      - bluetooth
      - ci_build
      - sysbuild
  sample.bluetooth.direct_test_mode_send.nrf2220:
    sysbuild: true
    build_only: true
    extra_args: SHIELD=nrf2220ek
    integration_platforms:
      - nrf5340dk/nrf5340/cpunet
      - nrf54l15dk/nrf54l15/cpuapp
    platform_allow:
      - nrf5340dk/nrf5340/cpunet
      - nrf54l15dk/nrf54l15/cpuapp
    tags:
      - bluetooth
      - ci_build
      - sysbuild
  sample.bluetooth.direct_test_mode_send.nrf5340_nrf2220_usb:
    sysbuild: true
    build_only: true
    extra_args:
      - SHIELD=nrf2220ek
      - FILE_SUFFIX=usb_5340
    integration_platforms:
      - nrf5340dk/nrf5340/cpunet
    platform_allow: nrf5340dk/nrf5340/cpunet
    tags:
      - bluetooth
      - ci_build
      - sysbuild
  sample.bluetooth.direct_test_mode_send.nrf54h20_usb:
    sysbuild: true
    build_only: true
    extra_args: FILE_SUFFIX=usb_54h20
    integration_platforms:
      - nrf54h20dk/nrf54h20/cpurad
    platform_allow: nrf54h20dk/nrf54h20/cpurad
    tags:
      - bluetooth
      - ci_build
      - sysbuild
```

## prj.conf
```kconfig
#
# Copyright (c) 2020 Nordic Semiconductor
#
# SPDX-License-Identifier: LicenseRef-Nordic-5-Clause
#

# Configure assertions
CONFIG_ASSERT=y
CONFIG_ASSERT_NO_COND_INFO=y
CONFIG_ASSERT_NO_MSG_INFO=y

CONFIG_HW_STACK_PROTECTION=y

CONFIG_CONSOLE=n
CONFIG_UART_CONSOLE=n

CONFIG_LOG=y
CONFIG_LOG_PRINTK=y
CONFIG_USE_SEGGER_RTT=y
CONFIG_LOG_BACKEND_RTT=y

# Use necessary peripherals
CONFIG_GPIO=y
CONFIG_NRFX_TIMER=y
CONFIG_NRFX_GPPI=y
CONFIG_CLOCK_CONTROL=y

CONFIG_FEM_AL_LIB=y
```

## boards/xiao_nrf54lm20a_nrf54lm20a_cpuapp.conf
```kconfig
#
# Copyright (c) 2026 Seeed Technology Co., Ltd.
#
# SPDX-License-Identifier: LicenseRef-Nordic-5-Clause
#

# DTM uses the XIAO exposed hardware serial pins through uart21.
CONFIG_CONSOLE=n
CONFIG_UART_CONSOLE=n
```

## boards/xiao_nrf54lm20b_nrf54lm20a_cpuapp.conf
```kconfig
#
# Copyright (c) 2026 Seeed Technology Co., Ltd.
#
# SPDX-License-Identifier: LicenseRef-Nordic-5-Clause
#

# DTM uses the XIAO exposed hardware serial pins through uart21.
CONFIG_CONSOLE=n
CONFIG_UART_CONSOLE=n

# Keep this DTM build on the standard 2-wire UART path.
CONFIG_USB_DEVICE_STACK=n
CONFIG_USB_DEVICE_STACK_NEXT=n
CONFIG_USB_CDC_ACM=n
```

## app.overlay
```dts
/ {
	chosen {
		ncs,dtm-uart = &uart20;
	};
};

&uart20 {
	status = "okay";
	current-speed = <19200>;
};

&radio {
	status = "okay";
	/*
	 * XIAO nRF54LM20A does not have a DFE antenna matrix.
	 * Delete dfe-supported to disable direction finding support
	 * and allow the DTM application to build.
	 */
	/delete-property/ dfe-supported;
};
```

## boards/nrf52840dk_nrf52840.overlay
```dts
/*
 * Copyright (c) 2020 Nordic Semiconductor
 *
 * SPDX-License-Identifier: LicenseRef-Nordic-5-Clause
 */

/ {
	chosen {
		ncs,dtm-uart = &uart0;
	};
};

&uart0 {
	status = "okay";
	current-speed = <19200>;
};
```

## boards/xiao_nrf54l15_nrf54l15_cpuapp.overlay
```dts
/*
 * Copyright (c) 2026 Seeed Technology Co., Ltd.
 *
 * SPDX-License-Identifier: LicenseRef-Nordic-5-Clause
 */

/ {
	chosen {
		ncs,dtm-uart = &uart20;
	};
};

&uart20 {
	status = "okay";
	current-speed = <19200>;
};

&radio {
	/delete-property/ dfe-supported;
};
```

## boards/xiao_nrf54lm20a_nrf54lm20a_cpuapp.overlay
```dts
/*
 * Copyright (c) 2026 Seeed Technology Co., Ltd.
 *
 * SPDX-License-Identifier: LicenseRef-Nordic-5-Clause
 */

/ {
	chosen {
		ncs,dtm-uart = &uart21;
	};
};

&uart21 {
	status = "okay";
	current-speed = <19200>;
};

&radio {
	/delete-property/ dfe-supported;
};
```

## src/main.c
```c
/*
 * Copyright (c) 2020 Nordic Semiconductor ASA
 *
 * SPDX-License-Identifier: LicenseRef-Nordic-5-Clause
 */

#include <zephyr/device.h>
#include <zephyr/drivers/gpio.h>
#include <zephyr/kernel.h>
#include <zephyr/sys/printk.h>
#include <zephyr/pm/device_runtime.h>

#include "transport/dtm_transport.h"

static const struct gpio_dt_spec status_led = GPIO_DT_SPEC_GET(DT_ALIAS(led0), gpios);

static void status_led_blink_thread(void)
{
	if (!gpio_is_ready_dt(&status_led)) {
		return;
	}

	if (gpio_pin_configure_dt(&status_led, GPIO_OUTPUT_INACTIVE) != 0) {
		return;
	}

	for (;;) {
		(void)gpio_pin_toggle_dt(&status_led);
		k_sleep(K_MSEC(500));
	}
}

K_THREAD_DEFINE(status_led_blink_thread_id, 512, status_led_blink_thread,
		NULL, NULL, NULL, 7, 0, 0);

int main(void)
{
	int err;
	union dtm_tr_packet cmd;

	printk("Starting Direct Test Mode sample\n");

#if defined(CONFIG_SOC_SERIES_NRF54HX)
	const struct device *dtm_uart = DEVICE_DT_GET_OR_NULL(DT_CHOSEN(ncs_dtm_uart));

	if (dtm_uart != NULL) {
		int ret = pm_device_runtime_get(dtm_uart);

		if (ret < 0) {
			printk("Failed to get DTM UART runtime PM: %d\n", ret);
		}
	}
#endif /* defined(CONFIG_SOC_SERIES_NRF54HX) */

	err = dtm_tr_init();
	if (err) {
		printk("Error initializing DTM transport: %d\n", err);
		return err;
	}

	for (;;) {
		cmd = dtm_tr_get();
		err = dtm_tr_process(cmd);
		if (err) {
			printk("Error processing command: %d\n", err);
			return err;
		}
	}
}
```
