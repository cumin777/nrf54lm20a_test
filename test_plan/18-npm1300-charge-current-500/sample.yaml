## test_plan/18-npm1300-charge-current-500/sample.yaml
```yaml
sample:
  name: XIAO nRF54LM20B nPM1300 fuel gauge 500mA

common:
  integration_platforms:
    - xiao_nrf54lm20b/nrf54lm20a/cpuapp
  platform_allow:
    - xiao_nrf54lm20b/nrf54lm20a/cpuapp
  tags:
    - pmic
    - charger
    - fuel_gauge
    - sysbuild
tests:
  sample.xiao_nrf54lm20b_npm1300_charge_current:
    sysbuild: true
    build_only: true
```

## test_plan/20b-all/sample.yaml
```yaml
sample:
  name: XIAO nRF54LM20B 20B All
common:
  sysbuild: true
  build_only: true
tests:
  sample.xiao_nrf54lm20b.20b_all:
    tags:
      - dfu
      - mcuboot
      - usb
      - xiao
    platform_allow:
      - xiao_nrf54lm20b/nrf54lm20b/cpuapp
    integration_platforms:
      - xiao_nrf54lm20b/nrf54lm20b/cpuapp
```

## test_plan/usb-boot-dfu/bringup/02-mcuboot-signed-led/Kconfig.sysbuild
```kconfig
config PARTITION_MANAGER
	default n

config MCUBOOT_SIGNATURE_USING_KMU
	default n

config MCUBOOT_GENERATE_DEFAULT_KEY_FILE
	default n

source "share/sysbuild/Kconfig"
```

## test_plan/usb-boot-dfu/bringup/04-usb-loader-build-only/sysbuild/mcuboot/boards/xiao_nrf54lm20b_nrf54lm20b_cpuapp.conf
```kconfig
CONFIG_SYS_CLOCK_EXISTS=n
CONFIG_NRF_GRTC_TIMER=n
CONFIG_CRACEN_IKG=n
CONFIG_FPROTECT=y

# Match Nordic's nRF54LM20B MCUboot validation path.
CONFIG_CRACEN_PROVISION_PROT_RAM_INV_SLOTS_ON_INIT=n

CONFIG_BOOT_MAX_IMG_SECTORS=256
CONFIG_NRF_RRAM_WRITE_BUFFER_SIZE=32
```
